## boards/shields/lism/Kconfig.defconfig
```kconfig
if SHIELD_LISM_L || SHIELD_LISM_R
    config ZMK_KEYBOARD_NAME
        default "LisM"

    config NFCT_PINS_AS_GPIOS
        default y

    config ZMK_SPLIT
        default y

    config ZMK_POINTING
        default y

    config ZMK_MOUSE
        default y
    
    # config PAW3222
    config PAT9125
        default y
    
    config INPUT
        default y
    
    # config SPI
    config I2C
        default y
# 追加
    config PINCTRL
        default y
endif
```

## config/west.yml
```yaml
manifest:
  remotes:
    - name: zmkfirmware
      url-base: https://github.com/zmkfirmware
    - name: sekigon-gonnoc
      url-base: https://github.com/sekigon-gonnoc
    - name: caksoylar
      url-base: https://github.com/caksoylar
    - name: 4mplelab
      url-base: https://github.com/4mplelab
    # 追加
    - name: amgskobo
      url-base: https://github.com/amgskobo
  projects:
    - name: zmk
      remote: zmkfirmware
      # main branch @ 2026-08-06 (Zephyr v4.1.0+zmk-fixes)
      revision: 268b1b1e82150460f00fd701bcd08583d5c75d29
      import: app/west.yml
    - name: zmk-driver-paw3222
      remote: sekigon-gonnoc
      revision: main
    - name: zmk-rgbled-widget
      remote: caksoylar
      # v0.3 support was split out to v0.3-branch; main now tracks ZMK main/Zephyr 4.x
      revision: main
    - name: zmk-feature-charge-indicator
      remote: 4mplelab
      revision: main
    # 追加
    - name: zmk-input-inertia
      remote: amgskobo
      revision: main
  self:
    path: config
```
